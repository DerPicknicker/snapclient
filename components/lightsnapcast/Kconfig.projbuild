## components/lightsnapcast/Kconfig.projbuild
```kconfig
menu "Player-Settings"
config FLIP_MCLK_LEVEL
            bool "Invert Logic Level MCLK"
            default false

config FLIP_WORD_SELECT_LEVEL
            bool "Invert Logic Level WordSelect"
            default false
            help
                Some Dacs can bridge their outputs. Word-Select is used for selecting the played audio channel.
config FLIP_BCLK_LEVEL
            bool "Invert Logic Level BCLK"
            default false
config DISABLE_APLL_ADJUST
            bool "Disable APLL_ADJUST"
            default false

endmenu
```
